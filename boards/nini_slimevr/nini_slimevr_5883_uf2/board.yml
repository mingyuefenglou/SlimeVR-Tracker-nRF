## boards/nini_slimevr/nini_slimevr_5883_uf2/board.yml
```yaml
# Copyright (c) 2024 Nordic Semiconductor ASA
# SPDX-License-Identifier: Apache-2.0

board:
  name: nini_slimevr_5883_uf2
  full_name: NiNi_Unicorn & MINGYUE Smol SlimeVR 5883
  vendor: nini_slimevr
  socs:
    - name: nrf52833
```
